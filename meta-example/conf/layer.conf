## meta-example/conf/layer.conf
```bitbake
# Dummy layer.conf
BBPATH =. "${LAYERDIR}:"
BBFILES += "${LAYERDIR}/recipes-*/*/*.bb \
            ${LAYERDIR}/recipes-*/*/*.bbappend"

BBFILE_COLLECTIONS += "example"
BBFILE_PATTERN_example = "^${LAYERDIR}/"
BBFILE_PRIORITY_example = "5"
LAYERSERIES_COMPAT_example = "scarthgap"
```

## meta-yocto-lab/conf/layer.conf
```bitbake
# Professional layer.conf for meta-yocto-lab
BBPATH =. "${LAYERDIR}:"
BBFILES += "${LAYERDIR}/recipes-*/*/*.bb \
            ${LAYERDIR}/recipes-*/*/*.bbappend"

BBFILE_COLLECTIONS += "yocto-lab"
BBFILE_PATTERN_yocto-lab = "^${LAYERDIR}/"
BBFILE_PRIORITY_yocto-lab = "6"
LAYERSERIES_COMPAT_yocto-lab = "scarthgap"
```
